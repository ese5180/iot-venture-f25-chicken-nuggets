## CMakeLists.txt
```
cmake_minimum_required(VERSION 3.20.0)
find_package(Zephyr REQUIRED HINTS $ENV{ZEPHYR_BASE})
project(pir_test)

target_include_directories(app PRIVATE
    ${CMAKE_CURRENT_SOURCE_DIR}/../../include
)

# Add test source
target_sources(app PRIVATE src/pir_test.c)

# Add PIR driver source
target_sources(app PRIVATE
    ${CMAKE_CURRENT_SOURCE_DIR}/../../src/pir.c
)
```

## prj.conf
```kconfig
CONFIG_ZTEST=y
CONFIG_ZTEST_ASSERT_VERBOSE=2

CONFIG_LOG=y
CONFIG_LOG_DEFAULT_LEVEL=3
```

## src/pir_test.c
```c
#include <zephyr/ztest.h>
#include "pir.h"

/* Test 1: pir_init() returns 0 when successful */
ZTEST(pir_test_suite, test_pir_init_success)
{
    int rc = pir_init();
    zassert_equal(rc, 0, "pir_init should return 0 on success");
}

/* Test 2: pir_read() returns 0 by default (no motion) */
ZTEST(pir_test_suite, test_pir_read_default_no_motion)
{
    int val = pir_read();
    zassert_equal(val, 0, "pir_read should return 0 when no motion is detected");
}

/* Test 3: pir_set_state() updates pir_read() value */
ZTEST(pir_test_suite, test_pir_set_state)
{
    pir_set_state(1);
    zassert_equal(pir_read(), 1, "pir_read() should return 1 after motion is set");
}

/* Test 4: pir_init() clears previous motion state */
ZTEST(pir_test_suite, test_pir_init_resets_state)
{
    /* simulate motion */
    pir_set_state(1);
    zassert_equal(pir_read(), 1,
                  "pir_read should return 1 after motion is set");

    /* re-initialize the PIR driver */
    int rc = pir_init();
    zassert_equal(rc, 0, "pir_init should still return 0 on success");

    /* after init, state should be cleared back to no motion */
    zassert_equal(pir_read(), 0,
                  "pir_init should reset state so pir_read returns 0");
}

ZTEST_SUITE(pir_test_suite, NULL, NULL, NULL, NULL, NULL);
```
